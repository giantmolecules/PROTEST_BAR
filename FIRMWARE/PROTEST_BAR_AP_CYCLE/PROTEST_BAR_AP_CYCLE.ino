//--------------------------------------------------------------------------------
//--------/ HEADER /---------------------------------------------------------------
//--------------------------------------------------------------------------------


//  August 31, 2019
//  PROTEST_BAR_AP_CYCLE
//  Brett Ian Balogh
//  brettbalogh@gmail.com


//--------------------------------------------------------------------------------
//--------/ INCLUDE /-------------------------------------------------------------
//--------------------------------------------------------------------------------

//#include <Adafruit_NeoPixel.h>
#include <NeoPixelBus.h>
#include <WiFi.h>

//--------------------------------------------------------------------------------
//--------/ DEFINE /--------------------------------------------------------------
//--------------------------------------------------------------------------------

#define PIN 21
#define NUM_LEDS 8
#define STATUS_LED 13

//--------------------------------------------------------------------------------
//--------/ DECLARE /-------------------------------------------------------------
//--------------------------------------------------------------------------------

NeoPixelBus<NeoGrbwFeature, Neo800KbpsMethod> strip(NUM_LEDS, PIN);
/*
String ssids[] = {
  "       ABUSE",
  "      OF",
  "     POWER",
  "    COMES",
  "   AS",
  "  NO",
  " SURPRISE"
};
*/
String ssids[] = {
  "          Your",
  "        data",
  "      is",
  "    a",
  "  battleground"
};

char prefixes[] = {'!', '"', '#', '$', '%', '&', '(', ')', '*', '+', '-', '.'};

char bssid[32];
int values[] = {16, 32, 64, 127, 255, 127, 64, 32};
int pastTime = 0;
int interval = 100;
int counter = 0;
bool toggle = false;

//--------------------------------------------------------------------------------
//--------/ SETUP /---------------------------------------------------------------
//--------------------------------------------------------------------------------

void setup() {
  pinMode(STATUS_LED, OUTPUT);
  strip.Begin();
  strip.Show();
}

//--------------------------------------------------------------------------------
//--------/ LOOP /----------------------------------------------------------------
//--------------------------------------------------------------------------------

void loop() {
  if (millis() - pastTime > interval) {
    if (toggle) {
      String ssidString;
      int index = counter % 5;
      //ssidString += prefixes[index];
      //ssidString += "  ";
      ssidString += ssids[index];
      ssidString.toCharArray(bssid, 32);
      WiFi.softAP(bssid, NULL);
      blink();
      counter++;
    }
    if (!toggle) {
      updateLED();
    }
    toggle = !toggle;
    pastTime = millis();
  }
}

//--------------------------------------------------------------------------------
//--------/ FUNCTIONS /-----------------------------------------------------------
//--------------------------------------------------------------------------------



//--------/ blink /---------------------------------------------------------------

void blink() {
  digitalWrite(STATUS_LED, HIGH);
  delay(20);
  digitalWrite(STATUS_LED, LOW);
}

//--------/ updateLED /-----------------------------------------------------------

void updateLED() {

  int temp = values[7];

  for (int i = NUM_LEDS - 1; i >= 1; i--) {
    values[i] = values[i - 1];
  }

  values[0] = temp;

  for (int i = 0; i < NUM_LEDS; i++) {
    strip.SetPixelColor(i, RgbwColor(0, 0, 0, values[i]));
  }

  delay(1);
  strip.Show();

}



//--------------------------------------------------------------------------------
//--------/ EOF /-----------------------------------------------------------------
//--------------------------------------------------------------------------------
